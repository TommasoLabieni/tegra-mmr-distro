## layers/meta-mmr-config/conf/layer.conf
```bitbake
# We have a conf and classes directory, add to BBPATH
BBPATH .= ":${LAYERDIR}"

# We have recipes-* directories, add to BBFILES
BBFILES += "${LAYERDIR}/recipes-*/*/*.bb \
            ${LAYERDIR}/recipes-*/*/*.bbappend"

BBFILE_COLLECTIONS += "meta-mmr-config"
BBFILE_PATTERN_meta-mmr-config = "^${LAYERDIR}/"
BBFILE_PRIORITY_meta-mmr-config = "50"

LAYERDEPENDS_meta-mmr-config = "core"
LAYERSERIES_COMPAT_meta-mmr-config = "scarthgap styhead"
```

## layers/meta-mmr-core/conf/layer.conf
```bitbake
# We have a conf and classes directory, add to BBPATH
BBPATH .= ":${LAYERDIR}"

# We have recipes-* directories, add to BBFILES
BBFILES += "${LAYERDIR}/recipes-*/*/*/*.bb \
            ${LAYERDIR}/recipes-*/*/*/*.bbappend"

BBFILE_COLLECTIONS += "meta-mmr-core"
BBFILE_PATTERN_meta-mmr-core = "^${LAYERDIR}/"
BBFILE_PRIORITY_meta-mmr-core = "50"

LAYERDEPENDS_meta-mmr-core = "core"
LAYERSERIES_COMPAT_meta-mmr-core = "scarthgap styhead"
```
