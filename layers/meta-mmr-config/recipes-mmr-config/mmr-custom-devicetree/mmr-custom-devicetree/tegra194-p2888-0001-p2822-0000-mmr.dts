#include "tegra194-p2888-0001-p2822-0000.dts"

/* sets pllaon as clock source for can interface */
/ {
	nvidia,dtsfilename = __FILE__;
	nvidia,dtbbuildtime = __DATE__, __TIME__;

	mttcan@c310000 {
		compatible = "nvidia,tegra194-mttcan";
		reg = <0x00 0xc310000 0x00 0x144 0x00 0xc311000 0x00 0x32 0x00 0xc312000 0x00 0x1000>;
		reg-names = "can-regs\0glue-regs\0msg-ram";
		interrupts = <0x00 0x28 0x04>;
		pll_source = "pllaon";
		clocks = <0x04 0x11c 0x04 0x0a 0x04 0x09 0x04 0x5b 0x04 0x5e>;
		clock-names = "can_core\0can_host\0can\0osc\0pllaon";
		resets = <0x04 0x04>;
		reset-names = "can";
		mram-params = <0x00 0x10 0x10 0x20 0x00 0x00 0x10 0x10 0x10>;
		tx-config = <0x00 0x10 0x00 0x40>;
		rx-config = <0x40 0x40 0x40>;
		bitrates = <0x1f4 0x7d0>;
		bittimes = <0x7d 0x00 0x0f 0x13 0x03 0x00 0x03 0xfa 0x00 0x00 0xae 0x17 0x00 0x01 0xfa 0x00 0x07 0x13 0x03 0x00 0x02 0x1f4 0x00 0x04 0x0f 0x02 0x00 0x03 0x3e8 0x00 0x01 0x10 0x06 0x00 0x03 0x7d0 0x00 0x00 0x10 0x06 0x00 0x02>;
		status = "okay";
		phandle = <0x33f>;
	};

	clocks-init {
		compatible = "nvidia,clocks-config";
		status = "okay";

		disable {
			clocks = <0x04 0x09 0x04 0x0b>;
		};
	};


};
